## config/west.yml
```yaml
manifest:
  remotes:
    - name: zmkfirmware
      url-base: https://github.com/zmkfirmware
  projects:
    - name: zmk
      remote: zmkfirmware
      revision: 6d7bbc8670d175fd63e8c834feb41f80e7b52e74
      import: app/west.yml
  self:
    path: config
```
