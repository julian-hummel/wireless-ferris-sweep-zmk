/*
 * Copyright (c) 2024 The ZMK Contributors
 *
 * SPDX-License-Identifier: MIT
 */

#include "sleeky.dtsi"

&kscan0 {
    col-gpios
        = <&pro_micro 10 GPIO_ACTIVE_HIGH>  // Col 0
        , <&pro_micro 16 GPIO_ACTIVE_HIGH>  // Col 1
        , <&pro_micro 14 GPIO_ACTIVE_HIGH>  // Col 2
        , <&pro_micro 15 GPIO_ACTIVE_HIGH>  // Col 3
        , <&pro_micro 18 GPIO_ACTIVE_HIGH>  // Col 4
        ;
};
