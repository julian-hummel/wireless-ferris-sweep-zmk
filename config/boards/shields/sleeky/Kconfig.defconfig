## config/boards/shields/sleeky/Kconfig.defconfig
```kconfig
# Copyright (c) 2024 The ZMK Contributors
# SPDX-License-Identifier: MIT

if SHIELD_SLEEKY_LEFT

config ZMK_KEYBOARD_NAME
    default "Sleeky"

config ZMK_SPLIT_ROLE_CENTRAL
    default y

endif

if SHIELD_SLEEKY_LEFT || SHIELD_SLEEKY_RIGHT

config ZMK_SPLIT
    default y

endif
```

## config/boards/shields/sleeky/Kconfig.shield
```kconfig
# Copyright (c) 2024 The ZMK Contributors
# SPDX-License-Identifier: MIT

config SHIELD_SLEEKY_LEFT
    def_bool $(shields_list_contains,sleeky_left)

config SHIELD_SLEEKY_RIGHT
    def_bool $(shields_list_contains,sleeky_right)
```
